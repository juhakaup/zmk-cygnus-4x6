## boards/shields/cygnus/Kconfig.defconfig
```kconfig
if SHIELD_CYGNUS_DONGLE

config ZMK_KEYBOARD_NAME
    default "Cygnus Dongle"

config BT_MAX_CONN
    default 7

config ZMK_COMBO_MAX_COMBOS_PER_KEY
    default 7

config BT_MAX_PAIRED
    default 7

endif

if SHIELD_CYGNUS_LEFT || SHIELD_CYGNUS_RIGHT

config ZMK_SPLIT
    default y

endif
```
